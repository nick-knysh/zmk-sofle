## config/west.yml
```yaml
manifest:
  remotes:
    - name: zmkfirmware
      url-base: https://github.com/zmkfirmware
      # Additional modules containing boards/shields/custom code can be listed here as well.
      # See:
      # - https://zmk.dev/docs/features/modules
      # - https://docs.zephyrproject.org/3.5.0/develop/west/manifest.html#projects
      # - name: gpeye    
      # url-base: https://github.com/GPeye
    - name: nice-view-mod
      url-base: https://github.com/nick-knysh
  projects:
    # - name: mario-peripheral-animation
    #   remote: gpeye
    #   revision: main 
    # - name: urchin-peripheral-animation   #new entry
    #   remote: gpeye                       #new entry
    #   revision: main                      #new entry
    - name: nice-view-mod
      remote: nice-view-mod
      revision: main
    - name: zmk
      remote: zmkfirmware
      revision: v0.3.0
      import: app/west.yml
  self:
    path: boards
```
